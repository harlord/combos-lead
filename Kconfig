## Kconfig
```kconfig
## Combo-Lead module Kconfig options

menu "Combo-Lead Module"

config COMBOS_LEAD
    bool "Enable Combo-Lead support"
    default y
    help
      Builds and enables the enhanced combo handler that adds leader-key
      support, first-key exclusions, slow-release, and related features.

config ZMK_COMBO
    bool "Compatibility alias for legacy combo engine option"
    select COMBOS_LEAD
    help
      Older keymap configurations used CONFIG_ZMK_COMBO.  This alias keeps
      them building by selecting COMBOS_LEAD automatically.

endmenu
```

## dts/bindings/combos/combos_lead.yaml
```yaml
# DT binding for the Combo-Lead module.

title: ZMK Combos (Combo-Lead)

description: Combos container

compatible: "zmk,combos"
extend: true  

child-binding:
  description: "A combo"

  properties:
    bindings:
      type: phandle-array
      required: true
    key-positions:
      type: array
      required: true
    key-positions-leader:
      type: array
      required: false
    timeout-ms:
      type: int
      default: 50
    require-prior-idle-ms:
      type: int
      default: -1
    key-positions-first-exclude:
      type: array
      required: false
    slow-release:
      type: boolean
    layers:
      type: array 
```

## dts/bindings/combos/zmk,combos.yaml
```yaml
# Copyright (c) 2020 The ZMK Contributors
# SPDX-License-Identifier: MIT

# Override binding for combo nodes that adds leader, first-exclude and slow-release support.

title: ZMK Combos (Combo-Lead)

description: Combos container with leader-key extensions

compatible: "zmk,combos"
extend: true

child-binding:
  description: "A combo"

  properties:
    bindings:
      type: phandle-array
      required: true
    key-positions:
      type: array
      required: true
    key-positions-leader:
      type: array
      required: false
    timeout-ms:
      type: int
      default: 50
    require-prior-idle-ms:
      type: int
      default: -1
    key-positions-first-exclude:
      type: array
      required: false
    slow-release:
      type: boolean
    layers:
      type: array 
```
